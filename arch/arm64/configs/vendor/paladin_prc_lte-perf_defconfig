## drivers/input/touchscreen/nt36532/Kconfig
```kconfig
#
# Novatek NT36532 touchscreen driver configuration
#
config TOUCHSCREEN_NT36532
	tristate "Novatek NT36532 host download SPI driver"
	help
	  Say Y here if you have a Novatek NT36xxx no flash touchscreen connected
	  to your system by SPI bus.
	  If unsure, say N.
```

## drivers/misc/ctn730/Kconfig
```kconfig
config NFC_NXP_CTN730
	bool "NXP CTN730 based driver"
	depends on I2C
	default y
	---help---
	  NXP CTN730 driver based on I2C.
	  This is a driver to provides I2C access to CTN730 NFC WLC device 
```

## drivers/misc/huaqinhardware_info/Kconfig
```kconfig
config HQHARDWARE_INFO
  bool CONFIG_HQHARDWARE_INFO
  default n
  help
    CONFIG_HQHARDWARE_INFO
```
